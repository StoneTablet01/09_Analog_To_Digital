## main/Kconfig.projbuild
```kconfig
menu "Example Configuration"

    choice EXAMPLE_ADC1_CHANNEL
        bool "ADC1 Channel Num"
        depends on IDF_TARGET_ESP32
        default EXAMPLE_ADC1_CHANNEL_7
        help
            The channel of ADC1 used in this example.

        config EXAMPLE_ADC1_CHANNEL_0
            bool "ADC1 Channel 0 (GPIO 36)"
        config EXAMPLE_ADC1_CHANNEL_1
            bool "ADC1 Channel 1 ()"
        config EXAMPLE_ADC1_CHANNEL_2
            bool "ADC1 Channel 2 ()"
        config EXAMPLE_ADC1_CHANNEL_3
            bool "ADC1 Channel 3 (GPIO 39)"
        config EXAMPLE_ADC1_CHANNEL_4
            bool "ADC1 Channel 4 (GPIO 32)"
        config EXAMPLE_ADC1_CHANNEL_5
            bool "ADC1 Channel 5 (GPIO 33)"
        config EXAMPLE_ADC1_CHANNEL_6
            bool "ADC1 Channel 6 (GPIO 34)"
        config EXAMPLE_ADC1_CHANNEL_7
            bool "ADC1 Channel 7 (GPIO 35)"
    endchoice

    choice EXAMPLE_ADC1_CHANNEL
        bool "ADC1 Channel Num"
        depends on IDF_TARGET_ESP32S2
        default EXAMPLE_ADC1_CHANNEL_7
        help
            The channel of ADC1 used in this example.

        config EXAMPLE_ADC1_CHANNEL_0
            bool "ADC1 Channel 0 (GPIO 11)"
        config EXAMPLE_ADC1_CHANNEL_1
            bool "ADC1 Channel 1 (GPIO 12)"
        config EXAMPLE_ADC1_CHANNEL_2
            bool "ADC1 Channel 2 (GPIO 13)"
        config EXAMPLE_ADC1_CHANNEL_3
            bool "ADC1 Channel 3 (GPIO 14)"
        config EXAMPLE_ADC1_CHANNEL_4
            bool "ADC1 Channel 4 (GPIO 15)"
        config EXAMPLE_ADC1_CHANNEL_5
            bool "ADC1 Channel 5 (GPIO 16)"
        config EXAMPLE_ADC1_CHANNEL_6
            bool "ADC1 Channel 6 (GPIO 17)"
        config EXAMPLE_ADC1_CHANNEL_7
            bool "ADC1 Channel 7 (GPIO 18)"
    endchoice

    config EXAMPLE_ADC1_CHANNEL
        int
        default 0 if EXAMPLE_ADC1_CHANNEL_0
        default 1 if EXAMPLE_ADC1_CHANNEL_1
        default 2 if EXAMPLE_ADC1_CHANNEL_2
        default 3 if EXAMPLE_ADC1_CHANNEL_3
        default 4 if EXAMPLE_ADC1_CHANNEL_4
        default 5 if EXAMPLE_ADC1_CHANNEL_5
        default 6 if EXAMPLE_ADC1_CHANNEL_6
        default 7 if EXAMPLE_ADC1_CHANNEL_7

    choice EXAMPLE_DAC_CHANNEL
        bool "DAC Channel Num"
        depends on IDF_TARGET_ESP32
        default EXAMPLE_DAC_CHANNEL_1
        help
            The channel of DAC used in this example.

        config EXAMPLE_DAC_CHANNEL_1
            bool "DAC Channel 1 (GPIO25)"
        config EXAMPLE_DAC_CHANNEL_2
            bool "DAC Channel 2 (GPIO26)"
    endchoice

    choice EXAMPLE_DAC_CHANNEL
        bool "DAC Channel Num"
        depends on IDF_TARGET_ESP32S2
        default EXAMPLE_DAC_CHANNEL_1
        help
            The channel of DAC used in this example.

        config EXAMPLE_DAC_CHANNEL_1
            bool "DAC Channel 1 (GPIO17)"
        config EXAMPLE_DAC_CHANNEL_2
            bool "DAC Channel 2 (GPIO18)"
    endchoice

    config EXAMPLE_DAC_CHANNEL
        int
        default 0 if EXAMPLE_DAC_CHANNEL_1
        default 1 if EXAMPLE_DAC_CHANNEL_2

endmenu
```
